	list		p=16f877A	
	#include	<p16f877A.inc>
__CONFIG H'3F31'
  GECIKME1	EQU	0x20    
GECIKME2	EQU	0x21    
GECIKME3	EQU	0x22  
SAYAC		EQU	0x23
SAYAC2		EQU	0x24
SAYACK2		EQU	0x24
	ORG     0x000           
	NOP
  	GOTO    BASLA
	ORG     0x004
GECIKME				
	MOVLW	0x08
	MOVWF	GECIKME1	
	
	MOVLW	0x2F
	MOVWF	GECIKME2
	MOVLW	0x03
	MOVWF	GECIKME3
DONGU1
	DECFSZ	GECIKME1,1
	GOTO	$+2
	DECFSZ	GECIKME2,1
	GOTO	$+2
	DECFSZ	GECIKME3,1
	GOTO	DONGU1
	
	NOP
	NOP
	NOP	
	RETURN

AYARLAR

	BANKSEL	TRISA
	MOVLW	0x06
	MOVWF	ADCON1		; ADC PASIF
	MOVLW	b'110000'	; RA4-5 GIRIS
	MOVWF	TRISA
	BANKSEL PORTA
	CLRF PORTA
	BANKSEL TRISB
	CLRF TRISB
	BANKSEL PORTB 
	CLRF PORTB
	RETURN

	
BASLA
	
	CALL AYARLAR
	
TEST

	BTFSC PORTA,4
	GOTO GERI
	BTFSS PORTA,5	
	GOTO TEST
	GOTO ILERI	
	GOTO TEST


GERI

	DECF SAYAC,F
	MOVF SAYAC,W
	MOVWF PORTB
	SUBLW D'255'
	CALL GECIKME
	BTFSS STATUS,Z	
	GOTO TEST
	GOTO KONTROL2
	
	

KONTROL2

	DECF SAYAC2
	MOVF SAYAC2,W
	MOVWF PORTA
	CALL GECIKME
	GOTO TEST

ILERI
		
	INCF SAYAC,F
	MOVF SAYAC,W
	MOVWF PORTB
	SUBLW D'256'	
	CALL GECIKME
	BTFSS STATUS,Z
	GOTO TEST
	GOTO KONTROL		

KONTROL
	
	INCF SAYAC2,F
	MOVF SAYAC2,W
	MOVWF PORTA
	CALL GECIKME
	GOTO ILERI



END